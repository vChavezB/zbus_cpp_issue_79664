## west.yml
```yaml
manifest:

  remotes:
    - name: zephyrproject-rtos
      url-base: https://github.com/zephyrproject-rtos

  projects:
    - name: zephyr
      remote: zephyrproject-rtos
      revision: 08a780800013162bc6d5e260bc976445c82c6ad1
      path: zephyr
      import:
        name-allowlist:
          - cmsis
```
